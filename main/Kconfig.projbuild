## main/Kconfig.projbuild
```kconfig
menu "WiFi Mode Configuration"

    menu "SoftAP Configuration"
        comment "SoftAP Configuration"

        config ESP_WIFI_AP_PASSWORD
            string "WiFi AP Password"
            default "12345678"
            help
                WiFi password of the AP for the example to use.

        config ESP_WIFI_AP_CHANNEL
            int "WiFi AP Channel"
            range 1 14
            default 1
            help
                WiFi channel (network channel) of the AP for the example to use.

        config ESP_MAX_STA_CONN_AP
            int "Maximal STA connections"
            default 4
            help
                Max number of the STA connects to AP.
    endmenu

endmenu

menu "Vortex Hub Link"

    menu "HUB Configuration"

        comment "Default hub (empty = not paired, the phone sets it)"

        config HUB_STORAGE_RESET
            bool "Reset hub storage to default"
            default n
            help
                Overwrite the saved hub with the defaults below on every boot.

        config HUB_DEFAULT_MAC
            string "Default hub MAC (AA:BB:CC:DD:EE:FF)"
            default ""
            help
                Hub STA MAC address. Empty = no hub.

        config HUB_DEFAULT_PAIR_KEY
            string "Default pair key (32 hex chars)"
            default ""
            help
                Same key as the hub. Empty = no hub.
    
    endmenu

    menu "Link Configuration"
    
        comment "Link timing"

        config LINK_SEARCH_TIME_S
            int "Hub search time before AP (s)"
            range 10 600
            default 45

        config LINK_AP_TIME_S
            int "AP window without a phone (s)"
            range 30 600
            default 90

        config LINK_FAIL_LIMIT
            int "Failed sends in a row before link is lost"
            range 1 20
            default 3

        config HUB_PUBLISH_PERIOD_MS
            int "Publish period to the hub (ms)"
            range 1000 60000
            default 5000
    
    endmenu

endmenu

menu "Device Configuration"
    menu "Device Data Configuration"
        comment "Device Data Configuration"

        config WIFI_VALVE_ID
            string "WiFi Valve ID"
            default "VA202601001"
            help
                Wifi valve device Id.

        config WS_PASSKEY_VALUE
            string "WebSocket Passkey"
            default "12345"
            help
                WebSocket passkey for the device.

    endmenu

    menu "Motor Driver Configuration"
        comment "Motor Driver Configuration"

        config MOTOR_EN_PIN
            int "MOTOR EN PIN"
            default 25
            help
                Motor Driver PWM pin number.

        config MOTOR_IN1_PIN
            int "MOTOR IN1 PIN"
            default 33
            help
                Motor Driver IN1 pin number.

        config MOTOR_IN2_PIN
            int "MOTOR IN2 PIN"
            default 32
            help
                Motor Driver IN2 pin number.

    endmenu

    menu "Limit Switches Configuration"
        comment "Limit Switches Configuration"

        config CLOSE_LIMIT_PIN_A
            int "CLOSE LIMIT PIN A"
            default 21
            help
                Close Limit Switch pin A number.

        config CLOSE_LIMIT_PIN_B
            int "CLOSE LIMIT PIN B"
            default 19
            help
                Close Limit Switch pin B number.

        config OPEN_LIMIT_PIN_A
            int "OPEN LIMIT PIN A"
            default 18
            help
                Open Limit Switch pin A number.

        config OPEN_LIMIT_PIN_B
            int "OPEN LIMIT PIN B"
            default 5
            help
                Open Limit Switch pin B number.
    endmenu

    menu "Potentiometer Configuration"
        comment "Potentiometer Configuration (32,33,34,35,36,39)"
        
            config POTENTIOMETER_PIN
                int "POTENTIOMETER PIN"
                default 34
                help
                    Potentiometer adc pin number.

    endmenu

    menu "LED Indicators Configuration"
        comment "LED Indicators Configuration"

        config RED_LED_PIN
            int "RED LED PIN"
            default 17
            help
                Red LED pin number.

        config GREEN_LED_PIN
            int "GREEN LED PIN"
            default 16
            help
                Green LED pin number.
    endmenu
    
endmenu
```
